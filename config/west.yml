## config/west.yml
```yaml
manifest:
  remotes:
    - name: zmkfirmware
      url-base: https://github.com/zmkfirmware
  
    - name: urob
      url-base: https://github.com/urob
      
    # Additional modules containing boards/shields/custom code can be listed here as well
    # See https://docs.zephyrproject.org/3.2.0/develop/west/manifest.html#projects
  projects:
    # - name: zmk
    #   remote: zmkfirmware
    #   revision: main
    #   import: app/west.yml

    # urob's zmk fork with mouse PR & many extra features, but may be
    # incompatible with the PS/2 mouse & TP driver module.
    - name: zmk
      remote: urob
      revision: main
      import: app/west.yml

    #
    # Additional zmk modules
    #

    # Urob's zmk helpers that contain key position defines
    - name: zmk-helpers
      remote: urob
      revision: v2 # this will eventually become main


  self:
    path: config
```
